## dts/bindings/behaviors/zmk,behavior-follower.yaml
```yaml
description: Trigger the behavior mapped to a certain position
compatible: "zmk,behavior-follower"
include: two_param.yaml
```

## src/behaviors/Kconfig
```kconfig
config ZMK_BEHAVIOR_TRIGGER_ON_BOOT_MAX_BEHAVIORS
    int "Maximum toggle-on-boot behaviors"
    default 4

config ZMK_BEHAVIOR_TRIGGER_ON_BOOT_DELAY_MS
    int "Delay for the autostarted behavior"
    default 50
```
